## Kconfig.projbuild
```kconfig
menu "My Audio Board"

choice CUSTOMER_AUDIO_BOARD
    prompt "My audio board"
    default RASPIAUDIO_V1_0
    help
        Select an audio board to use with the ESP-ADF

config RASPIAUDIO_V1_0
    bool "Muse proto boart v1.0"

endchoice

endmenu
```
